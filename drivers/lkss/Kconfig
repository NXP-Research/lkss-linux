## drivers/lkss/Kconfig
```kconfig
menuconfig LKSS_DRIVERS
	bool "Linux Kernel Summer School drivers"
	default n
	help
	  Enable support for Linux Kernel Summer School drivers.

if LKSS_DRIVERS

config LKSS_DRIVERS_LAB1
	bool "Linux Kernel Summer School lab 1 drivers"
	default n
	help
	  Enable support for lab 1 drivers.

source "drivers/lkss/lab1/Kconfig"

endif # LKSS_DRIVERS
```

## drivers/lkss/lab1/Kconfig
```kconfig
# SPDX-License-Identifier: GPL-2.0-only

if LKSS_DRIVERS_LAB1

config LKSS_DRIVERS_LAB1_EX1
	tristate "Lab1 Ex1 - Hello World"
	help
	  Compile Lab1 Ex1: Simple hello world module

config LKSS_DRIVERS_LAB1_EX4
	tristate "Lab1 Ex4 - Ooops module"
	help
	  Compile Lab1 Ex4: Simple module to generate an oops

config LKSS_DRIVERS_LAB1_EX5
	tristate "Lab1 Ex5 - Kernel API demo"
	help
	  Compile Lab1 Ex5: Module demonstrating kmalloc, kernel timers and spinlocks

config LKSS_DRIVERS_LAB1_EX6
	tristate "Lab1 Ex6 - Basic platform driver"
	help
	  Compile Lab1 Ex6: Basic platform driver to demonstrate DT properties API

endif # LKSS_DRIVERS_LAB1
```

## drivers/lkss/lab4/Kconfig
```kconfig
# SPDX-License-Identifier: GPL-2.0-only

if LKSS_DRIVERS_LAB4

config LKSS_DRIVERS_LAB4_EX
	tristate "Lab 4 - BMP280 I2C pressure/temperature sensor driver"
	help
	  Compile Lab4 BMP280 I2C pressure/temperature sensor driver

endif # LKSS_DRIVERS_LAB4
```
